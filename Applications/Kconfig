## Applications/Kconfig
```kconfig
menu "Applications"

config BUILD_APPLICATIONS
	bool "Build Applications"
	default y

config APP_ACTIVITY_MONITOR
	bool "Activity Monitor"
	depends on BUILD_APPLICATIONS
	default y

config APP_CALCULATOR
	bool "Calculator"
	depends on BUILD_APPLICATIONS
	default y

config APP_FILE_MANAGER
	bool "File Manager"
	depends on BUILD_APPLICATIONS
	default y

config APP_TERMINAL
	bool "Terminal"
	depends on BUILD_APPLICATIONS
	default y

config APP_TEXT_EDITOR
	bool "Code Editor"
	depends on BUILD_APPLICATIONS
	default y

config APP_BROWSER
	bool "Browser"
	depends on BUILD_APPLICATIONS
	default y

config APP_MAIL
	bool "Mail"
	depends on BUILD_APPLICATIONS
	default n

config APP_MEDIA_PLAYER
	bool "Media Player"
	depends on BUILD_APPLICATIONS
	default n

endmenu
```

## Kconfig
```kconfig
mainmenu "OnEOS Configuration"

config ONEOS_VERSION
	string "OnEOS Version"
	default "1.0.0"

config ONEOS_ARCH
	string "Architecture"
	default "x86"
	help
	  Select target architecture

choice
	prompt "Architecture Selection"
	default ARCH_X86

config ARCH_X86
	bool "x86"

config ARCH_ARM64
	bool "ARM64"

config ARCH_RISCV
	bool "RISCV"

endchoice

menu "Kernel Configuration"

config KERNEL_DEBUG
	bool "Enable kernel debugging"
	default n
	help
	  Enable kernel debug symbols

config KERNEL_MODULES
	bool "Enable kernel modules"
	default y
	help
	  Enable kernel module support

config KERNEL_PREEMPTION
	bool "Preemptible kernel"
	default y
	help
	  Enable kernel preemption

endmenu

menu "Driver Configuration"

config DRIVERS_BUILD
	bool "Build drivers"
	default y

config DRIVER_ATA
	bool "ATA driver"
	depends on DRIVERS_BUILD
	default y

config DRIVER_USB
	bool "USB driver"
	depends on DRIVERS_BUILD
	default y

config DRIVER_NETWORK
	bool "Network drivers"
	depends on DRIVERS_BUILD
	default y

endmenu

menu "Filesystem Configuration"

config FS_EXT4
	bool "EXT4 support"
	default y

config FS_BTRFS
	bool "BTRFS support"
	default n

config FS_NTFS
	bool "NTFS support"
	default n

config FS_VFAT
	bool "VFAT support"
	default y

endmenu

menu "Build Options"

config BUILD_OPTIMIZATION
	string "Optimization level"
	default "O2"

config BUILD_DEBUG_INFO
	bool "Include debug information"
	default y

config BUILD_STATIC
	bool "Build static binaries"
	default n

endmenu
```

## arch/Kconfig
```kconfig
menu "Architecture Selection"

choice
	prompt "Target Architecture"
	default ARCH_X86

config ARCH_X86
	bool "x86"
	help
	  Intel/AMD x86 architecture

config ARCH_ARM64
	bool "ARM64"
	help
	  ARM 64-bit architecture

config ARCH_RISCV
	bool "RISCV"
	help
	  RISCV open-source architecture

endchoice

menu "x86 Configuration"
	depends on ARCH_X86

config X86_64
	bool "64-bit x86"
	default y

config X86_32
	bool "32-bit x86"
	default n

endmenu

menu "ARM64 Configuration"
	depends on ARCH_ARM64

config ARM64_SMP
	bool "SMP Support"
	default y

endmenu

menu "RISCV Configuration"
	depends on ARCH_RISCV

config RISCV_64
	bool "64-bit RISCV"
	default y

endmenu

endmenu
```

## bin/Kconfig
```kconfig
menu "Binary Utilities"

config BUILD_TOOLS
	bool "Build Tools"
	default y

config CLI_UTILITIES
	bool "CLI Utilities"
	default y

config CORE_UTILITIES
	bool "Core Utilities"
	default y

config FILE_UTILITIES
	bool "File Utilities"
	default y

config MOUNT_UTILITIES
	bool "Mount Utilities"
	default y

config SYSTEM_UTILITIES
	bool "System Utilities"
	default y

config TEXT_PROCESSING
	bool "Text Processing"
	default y

endmenu
```

## compatibility-layer/Kconfig
```kconfig
menu "Compatibility Layer"

config COMPAT_LAYER
	bool "Build Compatibility Layer"
	default y

config COMPAT_POSIX
	bool "POSIX Compliance"
	depends on COMPAT_LAYER
	default y

config COMPAT_SYSCALL
	bool "System Call Mapping"
	depends on COMPAT_LAYER
	default y

config COMPAT_API_WRAPPER
	bool "API Wrapper Support"
	depends on COMPAT_LAYER
	default y

config COMPAT_EMULATION
	bool "Binary Emulation"
	depends on COMPAT_LAYER
	default y

config COMPAT_LIBRARY_LOADER
	bool "Library Loader"
	depends on COMPAT_LAYER
	default y

config COMPAT_ABI_LAYER
	bool "ABI Compatibility"
	depends on COMPAT_LAYER
	default y

config COMPAT_LEGACY_SUPPORT
	bool "Legacy Application Support"
	depends on COMPAT_LAYER
	default n

endmenu
```

## core-services/Kconfig
```kconfig
menu "Core Services"

config CORE_SERVICES
	bool "Build Core Services"
	default y

config DAEMON_MANAGER
	bool "Daemon Manager"
	depends on CORE_SERVICES
	default y

config SERVICE_MANAGER
	bool "Service Manager"
	depends on CORE_SERVICES
	default y

config PROCESS_MANAGER
	bool "Process Manager"
	depends on CORE_SERVICES
	default y

config LOGGING_SERVICE
	bool "Logging Service"
	depends on CORE_SERVICES
	default y

config IPC_SERVICE
	bool "IPC Service"
	depends on CORE_SERVICES
	default y

config EVENT_SERVICE
	bool "Event Service"
	depends on CORE_SERVICES
	default y

config TIMER_SERVICE
	bool "Timer Service"
	depends on CORE_SERVICES
	default y

config SCHEDULER
	bool "Scheduler"
	depends on CORE_SERVICES
	default y

endmenu
```

## drivers/Kconfig
```kconfig
menu "Driver Configuration"

config DRIVERS_BUILD
	bool "Build Drivers"
	default y

config DRIVER_ACPI
	bool "ACPI Support"
	depends on DRIVERS_BUILD
	default y

config DRIVER_ATA
	bool "ATA/SATA Driver"
	depends on DRIVERS_BUILD
	default y

config DRIVER_USB
	bool "USB Driver"
	depends on DRIVERS_BUILD
	default y

config DRIVER_AUDIO
	bool "Audio Driver"
	depends on DRIVERS_BUILD
	default y

config DRIVER_GPU
	bool "GPU Driver"
	depends on DRIVERS_BUILD
	default n

config DRIVER_NETWORK
	bool "Network Driver"
	depends on DRIVERS_BUILD
	default y

config DRIVER_NVME
	bool "NVME Driver"
	depends on DRIVERS_BUILD
	default y

endmenu
```

## fs/Kconfig
```kconfig
menu "Filesystem Configuration"

config FS_EXT4
	bool "EXT4 Support"
	default y

config FS_EXT3
	bool "EXT3 Support"
	default y

config FS_BTRFS
	bool "BTRFS Support"
	default n

config FS_VFAT
	bool "VFAT Support"
	default y

config FS_NTFS
	bool "NTFS Support"
	default n

config FS_NFS
	bool "NFS Support"
	default n

config FS_NETWORK
	bool "Network Filesystem Support"
	default n

endmenu
```

## kernel/Kconfig
```kconfig
menu "Kernel Configuration"

config KERNEL_VERSION
	string "Kernel Version"
	default "1.0.0"

config KERNEL_DEBUG
	bool "Enable Debug"
	default y

config KERNEL_MODULES
	bool "Enable Modules"
	default y

config KERNEL_SMP
	bool "SMP (Multiprocessor)"
	default y

config KERNEL_PREEMPT
	bool "Preemptible Kernel"
	default y

config KERNEL_MEMORY_SIZE
	int "Memory Size (MB)"
	default 1024

endmenu
```

## lib/Kconfig
```kconfig
menu "Standard C Libraries"

config LIB_C
	bool "C Standard Library (libc)"
	default y

config LIB_M
	bool "Math Library (libm)"
	default y

config LIB_PTHREAD
	bool "POSIX Threads (libpthread)"
	default y

config LIB_DL
	bool "Dynamic Linking Loader (libdl)"
	default y

config LIB_CRYPTO
	bool "Cryptography Library (libcrypto)"
	default y

config LIB_SSL
	bool "SSL/TLS Library (libssl)"
	default y

config LIB_CURL
	bool "HTTP Client Library (libcurl)"
	default y

config LIB_XML2
	bool "XML Library (libxml2)"
	default y

config LIB_Z
	bool "Compression Library (libz)"
	default y

config LIB_JSON_C
	bool "JSON-C Library (libjson-c)"
	default y

config LIB_GLIB
	bool "GLib Utility Library (libglib)"
	default y

config LIB_NCURSES
	bool "NCurses Library (libncurses)"
	default y

config LIB_READLINE
	bool "Readline Library (libreadline)"
	default y

config LIB_SYSTEMD
	bool "systemd Library (libsystemd)"
	default y

endmenu
```
